// 'MainScreen Bitmap
const unsigned char MainScreenImg [] PROGMEM = {
	0x00, 0x00, 0x00, 0x00, 0x00, 0x00, 0x00, 0x01, 0x80, 0x00, 0x00, 0x00, 0x81, 0x00, 0x00, 0x00, 
	0x00, 0x00, 0x00, 0x00, 0x00, 0x00, 0x00, 0x00, 0x00, 0x00, 0x00, 0x80, 0x00, 0x38, 0x00, 0xc1, 
	0x00, 0x00, 0x00, 0x00, 0x00, 0x00, 0x00, 0x00, 0x00, 0x00, 0x00, 0x00, 0x00, 0x00, 0x07, 0x00, 
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	0x00, 0x00
};


// Window Initialization
// Window testWindow = Window(); 
WindowReminder reminderWindow = WindowReminder(); 
WindowClock clockWindow = WindowClock();
WindowWeather weatherWindow = WindowWeather();
Window* listWindows[] = {&reminderWindow, &clockWindow, &weatherWindow}; // Clock window has idx 1
Window* listSecondWindows[] = {NULL, NULL, &weatherWindow}; // Optional Second Window for several windows

// Module Initialization
Module reminderModule = Module(green, iconReminder);
Module clockModule = Module(blue, iconClock);
Module weatherModule = Module(purple, iconWeather);

// List of our modules
Module listModules[] = {reminderModule, clockModule, weatherModule}; 
// int numElements = 3; // Number of modules in the menu
int numElements = sizeof(listModules) / sizeof(listModules[0]); // Get number of elements in listModules
String version = "V0.4.3"; 
int CENTER_SELECTED_IDX = (SELECTION_IDX + 1) % numElements; // Initial selection value - redefined in Screen.ino



// List of the three modules shown on the screen. 
Module displayModules[3] = {
  listModules[(SELECTION_IDX) % numElements],
  listModules[(SELECTION_IDX + 1) % numElements],
  listModules[(SELECTION_IDX + 2) % numElements]  
};

void updateCurrentScene(){
  // Make sure that the clock window is selected and the date is different than what it was before
  if((APP_LAYER == 2  && CENTER_SELECTED_IDX == 1) && (OLD_TIME != DATE_TIME)){
    listWindows[CENTER_SELECTED_IDX]->updateClock(DATE_TIME); // Update our text
    OLD_TIME = DATE_TIME; // Update time. 
  }
}

// Check if second layer selection is null.
bool selectionIsNull(int idx){
  return(listSecondWindows[idx] == NULL);
}

void toggleScreen(){
  if(SCREEN_RETRACTED){
    clearScreen(); // Turn off screen
  }else{
    updateWindows(); // Open to the screen we have. 
  }
}

// Update the screen based on the current layer that we're in.
void updateWindows(){
  switch(APP_LAYER){
    case(0): // Main Screen
      clearScreen();
      drawMainScreen(); 
      break;
    case(1): 
      if(PREV_SELECTION_IDX != SELECTION_IDX){ // Update modules only if we only requested a module change. 
        redrawModules();
      }else{ // If we switched a layer, draw the entire menu. 
        clearScreen(); 
        drawFullMenu();
      }
      break;
    case(2):
      drawSelectedWindow(CENTER_SELECTED_IDX); // Draw Window of selected index. 
      break;
    case(3): 
      drawSecondSelectWindow(CENTER_SELECTED_IDX); 
      break;
  } 
  // Update PREVIOUS values. 
  PREV_SELECTION_IDX = SELECTION_IDX; 
  PREV_APP_LAYER = APP_LAYER; 
  CENTER_SELECTED_IDX = (SELECTION_IDX + 1) % numElements; 
}

void updateSelectedScreen(){
  Serial.println("UPDATE CALL");
  switch(APP_LAYER){
    case(2):
      listWindows[CENTER_SELECTED_IDX]->update(); 
      break;
    case(3):
      break;
  }
}

void drawSelectedWindow(int selected){
  clearModules();
  listWindows[selected]->drawWindow();
}

// Draw second-layer selection
void drawSecondSelectWindow(int selected){
  if(listSecondWindows[selected] != NULL){
    clearModules(); 
    listSecondWindows[selected]->drawWindow(); 
  }else{
    Serial.println("ERROR in DRAWING SECOND WINDOW: SELECTION IS NULL");
  }
}

// Draw box of module height spanning the width of three modules
void clearModules(){
  tft.fillRoundRect(9, 75, 303, 110, 15, ST77XX_BLACK);          
}

// Draw the full menu.
void drawFullMenu(){
  drawTopOutline();
  drawModules();   // Draw the three selected modules
  drawPointer();   // Show selected
  drawBluetoothText(); 
  drawBluetoothStatus(BLUETOOTH_CONNECTED); 
}


// Redraw only our modules based on the new selection idx. 
void redrawModules(){
  // If our selection is out of bounds, reset the selection to the leftmost. 
  if(SELECTION_IDX < 0){
    SELECTION_IDX = numElements - 1; 
  }

  CENTER_SELECTED_IDX = (SELECTION_IDX + 1) % numElements; // Updated the selected window idx
  //Update Our Modules Accordingly
  displayModules[0] = listModules[(SELECTION_IDX) % numElements];
  displayModules[1] = listModules[(SELECTION_IDX + 1) % numElements];
  displayModules[2] = listModules[(SELECTION_IDX + 2) % numElements];

  // Draw updated modules
  drawModules(); 
}

// Draw the three modules 
void drawModules(){
  // Draw the three items in display modules
  for(int i = 0; i < 3; i++){ 
    displayModules[i].draw(i);
  }
}

void drawPointer(){
  tft.fillTriangle(148, 200,
                   160, 192,
                   172, 200, ST77XX_WHITE);
}

void hidePointer(){
  tft.fillTriangle(148, 200,
                  160, 192,
                  172, 200, ST77XX_BLACK);
}

void drawTopOutline(){
  // Border
  tft.drawRoundRect(9, 35, 305, 35, 15, ST77XX_WHITE); 
  drawText(version, 24, 45, 2); 
}

void drawBluetoothText(){
  drawText("Bluetooth: ", 150, 45, 2); 
}

// SHOULD BE USED TO MANAGE BT
void drawBluetoothStatus(bool isConnected){
  if(isConnected){
    tft.fillRoundRect(270, 45, 25, 15, 3, ST77XX_GREEN);
  } else {
    tft.fillRoundRect(270, 45, 25, 15, 3, ST77XX_RED);    
  }
}

// Draw Our Main Screen
void drawMainScreen(){
  drawTopOutline(); 
  drawBluetoothText();
  drawBluetoothStatus(deviceConnected); 
  drawText("IRIS", 9, 100, 5);
  tft.drawBitmap(164, 75, MainScreenImg, 150, 150, ST77XX_WHITE);
  
}

void drawText(String text, int x, int y, int size) {
  tft.setCursor(x, y);
  tft.setTextSize(size);
  tft.setTextColor(ST77XX_WHITE);
  tft.setTextWrap(true);
  tft.print(text);
}

void drawColorText(String text, int x, int y, int size, uint16_t color){
  tft.setCursor(x, y);
  tft.setTextSize(size);
  tft.setTextColor(color);
  tft.setTextWrap(true);
  tft.print(text);
}

// Used for fast erasing
void drawShadowText(String text, int x, int y, int size) {
  tft.setCursor(x, y);
  tft.setTextSize(size);
  tft.setTextColor(ST77XX_BLACK);
  tft.setTextWrap(true);
  tft.print(text);
}

// Init Screen
void screenStart(){
  tft.init(240, 320);
  tft.setRotation(1);  // 320x240 (Rotated)
  clearScreen();
}


void clearScreen(){
  tft.fillRect(0, 0, 320, 240, ST77XX_BLACK);
  // tft.fillRect(ST77XX_BLACK)
  // tft.fillScreen(ST77XX_BLACK); 
}